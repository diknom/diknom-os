## board/diknom/normal/i686/diknom_i686_defconfig
```kconfig
# ============================================================
#  DikNom OS - rasa normal 32-bit: glibc, programmer, wifi
#  Kenapa glibc: Node.js resmi, banyak Python wheel, dan binary
#  pra-kompilasi Rust hanya untuk glibc. musl memaksa semua
#  dibangun dari source sendiri.
# ============================================================
BR2_i386=y
BR2_x86_i686=y
BR2_LINUX_KERNEL_DEFCONFIG="i386"
BR2_TOOLCHAIN_BUILDROOT_GLIBC=y
BR2_TOOLCHAIN_BUILDROOT_CXX=y
BR2_KERNEL_HEADERS_AS_KERNEL=y

BR2_INIT_BUSYBOX=y
BR2_ROOTFS_DEVICE_CREATION_DYNAMIC_MDEV=y

BR2_TARGET_GENERIC_HOSTNAME="diknom-work"
BR2_TARGET_GENERIC_ISSUE="DikNom OS 0.1 (Blitar Edition)"
BR2_TARGET_GENERIC_ROOT_PASSWD="diknom"
BR2_SYSTEM_BIN_SH_BUSYBOX=y

BR2_LINUX_KERNEL=y
BR2_LINUX_KERNEL_CUSTOM_VERSION=y
BR2_LINUX_KERNEL_CUSTOM_VERSION_VALUE="6.6.30"
BR2_LINUX_KERNEL_USE_DEFCONFIG=y
BR2_LINUX_KERNEL_CONFIG_FRAGMENT_FILES="board/diknom/common/kernel-live.fragment board/diknom/common/kernel-wifi.fragment"
BR2_LINUX_KERNEL_INSTALL_TARGET=y

BR2_TARGET_ROOTFS_CPIO=y
BR2_TARGET_ROOTFS_CPIO_GZIP=y

BR2_ROOTFS_OVERLAY="board/diknom/common/rootfs-overlay"
BR2_ROOTFS_POST_BUILD_SCRIPT="board/diknom/common/post-build.sh"
BR2_ROOTFS_POST_IMAGE_SCRIPT="board/diknom/common/post-image.sh"

# --- inti sistem ---
BR2_PACKAGE_BUSYBOX_SHOW_OTHERS=y
BR2_PACKAGE_NANO=y
BR2_PACKAGE_VIM=y
BR2_PACKAGE_HTOP=y
BR2_PACKAGE_TMUX=y
BR2_PACKAGE_LESS=y
BR2_PACKAGE_KMOD=y
BR2_PACKAGE_UTIL_LINUX=y
BR2_PACKAGE_UTIL_LINUX_BINARIES=y
BR2_PACKAGE_PROCPS_NG=y
BR2_PACKAGE_FILE=y
BR2_PACKAGE_TAR=y
BR2_PACKAGE_GZIP=y
BR2_PACKAGE_XZ=y
BR2_PACKAGE_ZSTD=y
BR2_PACKAGE_RSYNC=y
BR2_PACKAGE_WGET=y
BR2_PACKAGE_LIBCURL=y
BR2_PACKAGE_LIBCURL_CURL=y
BR2_PACKAGE_CA_CERTIFICATES=y

# --- toolchain kerja ---
BR2_PACKAGE_GCC_FINAL=y
BR2_PACKAGE_BINUTILS=y
BR2_PACKAGE_MAKE=y
BR2_PACKAGE_PKGCONF=y
BR2_PACKAGE_GIT=y
BR2_PACKAGE_PYTHON3=y
BR2_PACKAGE_PYTHON3_SSL=y
BR2_PACKAGE_OPENSSH=y
BR2_PACKAGE_STRACE=y

# --- jaringan + wifi ---
BR2_PACKAGE_IW=y
BR2_PACKAGE_WPA_SUPPLICANT=y
BR2_PACKAGE_WPA_SUPPLICANT_CLI=y
BR2_PACKAGE_WPA_SUPPLICANT_NL80211=y
BR2_PACKAGE_LINUX_FIRMWARE=y
BR2_PACKAGE_LINUX_FIRMWARE_IWLWIFI_3168=y
BR2_PACKAGE_LINUX_FIRMWARE_IWLWIFI_7265D=y
BR2_PACKAGE_LINUX_FIRMWARE_IWLWIFI_8265=y
BR2_PACKAGE_LINUX_FIRMWARE_IWLWIFI_9XXX=y
BR2_PACKAGE_LINUX_FIRMWARE_IWLWIFI_22000=y
BR2_PACKAGE_LINUX_FIRMWARE_IWLWIFI_22260=y
BR2_PACKAGE_LINUX_FIRMWARE_IWLWIFI_6E=y
BR2_PACKAGE_LINUX_FIRMWARE_IWLWIFI_QUZ=y
BR2_PACKAGE_LINUX_FIRMWARE_RTL_88XX=y
BR2_PACKAGE_LINUX_FIRMWARE_RTL_RTW88=y
BR2_PACKAGE_LINUX_FIRMWARE_RTL_RTW89=y
BR2_PACKAGE_LINUX_FIRMWARE_ATHEROS_6003=y
BR2_PACKAGE_LINUX_FIRMWARE_RTL_81XX=y
BR2_PACKAGE_ETHTOOL=y

# --- percepat rebuild: ccache dibagi lewat cache Actions ---
BR2_CCACHE=y
BR2_CCACHE_DIR="$(HOME)/.buildroot-ccache"
BR2_CCACHE_INITIAL_SETUP="--max-size=5G"
BR2_CCACHE_USE_BASEDIR=y
```
